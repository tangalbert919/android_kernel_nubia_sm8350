/* Copyright (c) 2016-2017, The Linux Foundation. All rights reserved.
 *
 * This program is free software; you can redistribute it and/or modify
 * it under the terms of the GNU General Public License version 2 and
 * only version 2 as published by the Free Software Foundation.
 *
 * This program is distributed in the hope that it will be useful,
 * but WITHOUT ANY WARRANTY; without even the implied warranty of
 * MERCHANTABILITY or FITNESS FOR A PARTICULAR PURPOSE.  See the
 * GNU General Public License for more details.
 */

&mdss_mdp {
	dsi_nubia_r66451_amoled_cmd_cphy: qcom,mdss_dsi_r66451_1080_2340_amoled_cmd {
		qcom,mdss-dsi-panel-name = "dsi r66451 1080 2340 amoled command panel";
		qcom,mdss-dsi-panel-type = "dsi_cmd_mode";
		qcom,mdss-dsi-panel-physical-type = "oled";
		qcom,mdss-dsi-virtual-channel-id = <0>;
		qcom,mdss-dsi-stream = <0>;
		qcom,mdss-dsi-bpp = <24>;
		qcom,mdss-dsi-color-order = "rgb_swap_rgb";
		qcom,mdss-dsi-underflow-color = <0xff>;
		qcom,mdss-dsi-border-color = <0>;

		qcom,dsi-ctrl-num = <0>;
		qcom,dsi-phy-num = <0>;

		qcom,mdss-dsi-traffic-mode = "non_burst_sync_event";
		//qcom,mdss-dsi-lane-map = "lane_map_0123";
		qcom,mdss-dsi-bllp-eof-power-mode;
		qcom,mdss-dsi-bllp-power-mode;
		qcom,mdss-dsi-lane-0-state;
		qcom,mdss-dsi-lane-1-state;
		qcom,mdss-dsi-lane-2-state;
		//qcom,mdss-dsi-lane-3-state; //cphy only 3 lanes
		qcom,mdss-dsi-dma-trigger = "trigger_sw";
		qcom,mdss-dsi-mdp-trigger = "none";
		//qcom,mdss-dsi-reset-sequence =<1 6>;
		qcom,mdss-dsi-reset-sequence = <1 10>, <0 10>, <1 10>;
		qcom,mdss-dsi-tx-eot-append; //???
		qcom,mdss-dsi-rx-eot-ignore; //???
		qcom,mdss-dsi-bl-pmic-control-type = "bl_ctrl_dcs";
		qcom,mdss-dsi-bl-min-level = <1>;
		qcom,mdss-dsi-bl-max-level = <4095>;
		qcom,mdss-brightness-max-level = <4095>;
		qcom,mdss-dsi-te-pin-select = <1>;
		qcom,mdss-dsi-wr-mem-start = <0x2c>;
		qcom,mdss-dsi-wr-mem-continue = <0x3c>;

		//qcom,panel-supply-entries = <&dsi_panel_pwr_supply>;
		qcom,panel-supply-entries = <&dsi_panel_pwr_supply>;

		qcom,platform-te-gpio = <&tlmm 82 0>;
		qcom,platform-reset-gpio = <&tlmm 24 0>;
		//qcom,panel-lhbm-gpio = <&tlmm 55 0>;
		qcom,panel-dvdd-1p2-gpio = <&tlmm 83 0>;

		qcom,mdss-dsi-te-dcs-command = <1>;
		qcom,mdss-dsi-te-check-enable;
		qcom,mdss-dsi-te-using-te-pin;
		//qcom,mdss-dsi-t-clk-post = <0x17>;
		//qcom,mdss-dsi-t-clk-pre = <0x18>;

		//qcom,mdss-dsi-panel-hdr-enabled;
		//qcom,mdss-dsi-panel-hdr-color-primaries = <14500 15500 32000
			//17000 15500 30000 8000 3000>;
		qcom,mdss-dsi-panel-peak-brightness = <4200000>;
		qcom,mdss-dsi-panel-blackness-level = <3230>;
		//qcom,mdss-dsi-qsync-min-refresh-rate = <55>;

		qcom,mdss-pan-physical-width-dimension = <72>;
		qcom,mdss-pan-physical-height-dimension = <156>;

		qcom,panel-cphy-mode;

		qcom,mdss-dsi-display-timings {
			timing@0 {
				qcom,mdss-dsi-panel-framerate = <90>;
				qcom,mdss-dsi-panel-width = <1080>;
				qcom,mdss-dsi-panel-height = <2340>;
				qcom,mdss-dsi-h-front-porch = <85>;
				qcom,mdss-dsi-h-back-porch = <35>;
				qcom,mdss-dsi-h-pulse-width = <1>;
				qcom,mdss-dsi-h-sync-skew = <0>;
				qcom,mdss-dsi-v-back-porch = <4>;
				qcom,mdss-dsi-v-front-porch = <24>;
				qcom,mdss-dsi-v-pulse-width = <1>;
				qcom,mdss-dsi-h-left-border = <0>;
				qcom,mdss-dsi-h-right-border = <0>;
				qcom,mdss-dsi-v-top-border = <0>;
				qcom,mdss-dsi-v-bottom-border = <0>;
				qcom,mdss-mdp-transfer-time-us = <8000>;
				qcom,mdss-dsi-panel-jitter = <0x3C 0x0a>;

				qcom,mdss-dsi-on-command = [
					39 01 00 00 00 00 02 B0 00
					39 01 00 00 00 00 20 B3 00 22 00 02 08 00 10 00 00 00 00 00 00 00 00 00 00 00 00 00 00 00 00 00 00 00 00 00 00 00 04
					39 01 00 00 00 00 03 B4 20 1C
					39 01 00 00 00 00 0D B6 6C 00 06 23 AF 13 1A 05 04 FA 05 20
					39 01 00 00 00 00 02 B8 57
					39 01 00 00 00 00 02 B9 6F
					39 01 00 00 00 00 02 BA B5
					39 01 00 00 00 00 32 BB 59 C8 C8 C8 C8 C8 C8 C8 C8 C8 4A 48 46 44 42 40 3E 3C 3A 00 FF FF FF FF FF FF FF FF FF 04 00 04 04 42 04 69 5A 00 0B 76 0F FF 0F FF 0F FF 14 81 F4
					39 01 00 00 00 00 0C BC 45 26 C3 1F 19 06 03 C0 00 00 10
					39 01 00 00 00 00 0C BD 33 4C C3 52 32 1F 03 F2 00 00 13
					39 01 00 00 00 00 0C BE 25 68 C3 AA 3F 32 03 FF 00 00 25
					39 01 00 00 00 00 0D C0 00 00 00 00 00 00 00 00 00 00 00 00
					39 01 00 00 00 00 7D C1 94 42 00 16 05 00 00 00 10 00 10 00 AA 8A 02 10 00 10 00 00 3F 3F 03 FF 03 FF 23 FF 03 FF 23 FF 03 FF 00 40 40 00 00 10 06 00 06 00 00 00 10 00 00 00 00 10 00 00 00 00 10 00 00 20 02 10 01 10 00 00 00 00 00 20 04 20 02 10 00 00 00 00 00 00 00 10 00 00 00 00 00 00 00 00 00 10 00 00 00 00 00 00 00 00 00 00 00 00 00 00 00 00 00 00 00 00 00 00 00 00 00 00 00 00 00 00 00 00
					39 01 00 00 00 00 1A C2 09 24 0C 00 00 10 00 00 00 09 40 00 00 00 00 00 00 00 00 00 00 00 30 00 6C
					39 01 00 00 00 00 29 C3 00 12 30 02 88 88 A8 A8 A8 A8 A8 A8 A8 A8 A8 A8 A8 A8 A8 A8 A8 A8 A8 A8 AA 09 00 00 10 00 00 00 00 00 00 00 00 00 00 00
					39 01 00 00 00 00 32 C4 00 00 00 00 00 00 00 00 0D 00 00 05 00 00 00 36 00 01 00 00 00 00 00 00 00 00 00 00 00 22 00 00 00 00 11 00 00 0C 00 00 00 00 30 00 00 00 00 00 00
					39 01 00 00 00 00 0A C5 0A 00 4D 8B 4D 8B 4D 8B 00
					39 01 00 00 00 00 91 C6 00 00 03 FF 0F FC 03 FF 0F FC 03 FF 0F FC 03 FF 0F FC 03 FF 0F FC 03 FF 0F FC 03 FF 0F FC 03 FF 0F FC 03 FF 0F FC 03 FF 0F FC 03 FF 0F FC 0F FC 00 00 03 FF 0F FC 03 FF 0F FC 03 FF 0F FC 03 FF 0F FC 03 FF 0F FC 03 FF 0F FC 03 FF 0F FC 03 FF 0F FC 03 FF 0F FC 03 FF 0F FC 03 FF 0F FC 0F FC 00 00 03 FF 0F FC 03 FF 0F FC 03 FF 0F FC 03 FF 0F FC 03 FF 0F FC 03 FF 0F FC 03 FF 0F FC 03 FF 0F FC 03 FF 0F FC 03 FF 0F FC 03 FF 0F FC 0F FC
					39 01 00 00 00 00 91 C7 00 00 00 04 02 A2 00 08 02 A3 00 24 03 F6 00 40 04 3B 00 90 05 BA 01 01 06 AA 01 81 07 C9 02 02 08 6E 02 82 09 27 03 23 09 DE 03 83 0A 51 0A D5 00 00 00 04 02 6F 00 08 02 70 00 24 04 19 00 40 04 84 00 90 05 B6 01 01 06 9E 01 81 07 A0 02 02 08 42 02 82 08 EC 03 23 09 97 03 83 0A 00 0A 78 00 00 00 04 05 77 00 08 05 78 00 24 05 88 00 40 05 F2 00 90 06 F8 01 01 07 E9 01 81 08 E7 02 02 09 95 02 82 0A 53 03 23 0B 16 03 83 0B 8E 0C 19
					39 01 00 00 00 00 91 C8 00 00 00 04 02 A5 00 08 02 A6 00 24 03 63 00 40 04 04 00 90 05 FF 01 01 06 CE 01 81 07 F1 02 02 08 A2 02 82 09 5E 03 23 0A 26 03 83 0A A4 0B 34 00 00 00 04 03 16 00 08 03 17 00 24 03 D1 00 40 04 34 00 90 05 B9 01 01 06 92 01 81 07 A2 02 02 08 4F 02 82 09 07 03 23 09 C7 03 83 0A 37 0A C6 00 00 00 04 04 28 00 08 04 29 00 24 04 AB 00 40 05 52 00 90 06 CF 01 01 07 C5 01 81 08 EA 02 02 09 AA 02 82 0A 77 03 23 0B 4D 03 83 0B D2 0C 71
					39 01 00 00 00 00 91 C9 00 00 00 04 02 36 00 08 02 37 00 24 03 53 00 40 04 2F 00 90 05 FF 01 01 06 DE 01 81 07 FB 02 02 08 BC 02 82 09 87 03 23 0A 64 03 83 0A EF 0B 9F 00 00 00 04 02 B6 00 08 02 B7 00 24 03 63 00 40 04 01 00 90 05 AD 01 01 06 8E 01 81 07 A8 02 02 08 63 02 82 09 29 03 23 09 FC 03 83 0A 84 0B 21 00 00 00 04 03 7D 00 08 03 7E 00 24 04 4A 00 40 05 12 00 90 06 C0 01 01 07 C4 01 81 08 F3 02 02 09 C0 02 82 0A 9D 03 23 0B 89 03 83 0C 25 0C D8
					39 01 00 00 00 00 91 CA 00 00 00 04 02 02 00 08 02 03 00 24 03 F8 00 40 04 52 00 90 05 FF 01 01 06 EF 01 81 08 1B 02 02 08 E7 02 82 09 CB 03 23 0A D2 03 83 0B 6B 0C 53 00 00 00 04 02 8F 00 08 02 90 00 24 03 3F 00 40 03 FC 00 90 05 AC 01 01 06 9B 01 81 07 C4 02 02 08 88 02 82 09 6A 03 23 0A 66 03 83 0A F1 0B C8 00 00 00 04 03 22 00 08 03 23 00 24 04 71 00 40 05 0F 00 90 06 C0 01 01 07 D0 01 81 09 0C 02 02 09 E9 02 82 0A DF 03 23 0B F9 03 83 0C A3 0D 98
					39 01 00 00 00 00 91 CB 00 00 00 04 02 20 00 08 02 21 00 24 04 29 00 40 04 91 00 90 06 51 01 01 07 4D 01 81 08 83 02 02 09 77 02 82 0A 6F 03 23 0B AF 03 83 0C 62 0D 99 00 00 00 04 02 8B 00 08 02 8C 00 24 03 7B 00 40 04 3A 00 90 06 05 01 01 06 FD 01 81 08 35 02 02 09 1B 02 82 0A 09 03 23 0B 30 03 83 0B E3 0C ED 00 00 00 04 03 28 00 08 03 29 00 24 04 C5 00 40 05 45 00 90 07 1F 01 01 08 35 01 81 09 80 02 02 0A 86 02 82 0B 8A 03 23 0C DF 03 83 0D A7 0E F8
					39 01 00 00 00 00 44 CD 1C 00 FC FC FC 00 00 00 00 00 00 00 00 00 00 00 00 00 00 00 00 00 00 00 00 00 00 00 00 00 00 00 00 00 00 00 00 00 00 00 00 00 00 00 00 00 00 00 00 00 00 00 00 00 00 00 00 00 00 00 00 00 00 00 00 08 00
					39 01 00 00 00 00 86 CF 64 0B 00 22 00 CD 03 33 08 00 0B 77 01 01 01 02 02 03 03 04 04 04 04 05 02 C9 02 C9 02 C9 02 C9 02 C9 02 C9 02 C9 02 C9 02 C9 03 FF 03 FF 03 FF 02 C9 02 C9 02 C9 02 C9 02 C9 02 C9 02 C9 02 C9 02 C9 03 FF 03 FF 03 FF 01 62 01 62 01 62 01 62 01 62 01 62 01 62 01 62 01 62 01 62 01 62 01 62 23 23 23 23 23 23 23 23 23 23 23 23 00 00 00 43 00 43 01 98 01 98 06 61 06 61 0F F6 0F F6 0F F6 0F F6 0F F6 19
					39 01 00 00 00 00 0D D0 44 44 B2 28 00 28 5A 00 5A 0D 17 01
					39 01 00 00 00 00 40 D1 0B 00 21 02 24 23 24 48 00 00 00 00 00 00 00 00 00 00 00 00 00 00 00 00 00 00 00 00 00 00 00 00 00 00 00 00 00 00 00 00 00 00 00 00 00 00 00 00 00 00 00 00 4A 00 4A 00 4A 00 4A 00 4A 00 01
					39 01 00 00 00 00 35 D3 45 00 00 01 13 15 00 15 07 0F 77 77 77 37 B2 11 00 A0 3C 95 00 3E 6A 10 60 10 01 03 73 07 FF 04 44 33 33 83 04 00 00 00 00 00 00 00 3C 00 7E 7E 7E 00 42 01
					39 01 00 00 00 00 12 D4 00 00 00 00 00 00 00 00 20 00 00 00 00 00 20 00 00
					39 01 00 00 00 00 04 D5 00 00 00
					39 01 00 00 00 00 02 D6 00
					39 01 00 00 00 00 1A D7 00 B9 40 00 40 00 00 E0 0E 00 40 00 00 00 00 00 00 19 40 00 00 00 00 E0 0E
					39 01 00 00 00 00 3C D8 00 00 00 00 00 00 00 00 00 3C 00 3C 00 3C 00 3C 00 3C 05 00 00 00 00 00 00 00 00 00 0E 00 0E 00 00 00 00 00 00 00 00 00 00 00 00 00 0E 00 36 00 0E 00 30 00 00 00 00 00 00 00 00
					39 01 00 00 00 00 7A D9 00 13 12 1B 1A 02 00 00 00 00 00 00 00 00 00 00 00 00 00 00 00 00 00 00 00 00 00 00 00 00 00 00 00 00 00 00 00 00 00 00 00 00 00 00 96 1A 1B 12 13 00 00 00 00 00 00 00 00 00 00 00 00 00 00 00 00 00 00 00 00 00 00 00 00 00 00 00 00 00 00 00 00 00 00 00 00 00 00 00 00 00 00 00 00 00 00 00 00 00 00 00 00 00 00 00 00 00 00 00 08 1F 00 00 00 00 F0 00 00 00 00 00 00
					39 01 00 00 00 00 09 DD 30 06 23 65 30 06 23 65
					39 01 00 00 00 00 0E DE 01 10 10 00 4D 8B 55 4D 8B AA 4D 8B F0
					39 01 00 00 00 00 2B DF 50 42 58 81 2D 00 00 00 00 00 00 6B 00 00 00 00 00 00 00 00 21 00 FF D4 0E 00 00 00 00 00 20 00 53 18 20 00 00 00 00 00 00 00
					39 01 00 00 00 00 1A E9 00 00 00 0F FF 00 00 00 00 00 00 10 00 01 FF 03 FF 01 0E 02 58 02 1C 04 B0
					39 01 00 00 00 00 03 EB 8B 8B
					39 01 00 00 00 00 02 F7 01
					39 01 00 00 00 00 02 F2 00
					39 01 00 00 00 00 06 F3 00 00 00 00 00
					39 01 00 00 00 00 BD F8 11 00 00 89 30 80 09 24 04 38 00 14 02 1C 02 1C 02 00 02 0E 00 20 01 E8 00 07 00 0C 05 0E 05 16 18 00 10 F0 03 0C 20 00 06 0B 0B 33 0E 1C 2A 38 46 54 62 69 70 77 79 7B 7D 7E 01 02 01 00 09 40 09 BE 19 FC 19 FA 19 F8 1A 38 1A 78 1A B6 2A F6 2B 34 2B 74 3B 74 6B F4 00 00 00 00 00 00 11 00 00 AB 30 80 09 24 04 38 00 14 02 1C 02 1C 02 00 02 0E 00 20 01 E8 00 07 00 0C 05 0E 05 16 18 00 10 F0 07 10 20 00 06 0F 0F 33 0E 1C 2A 38 46 54 62 69 70 77 79 7B 7D 7E 02 02 22 00 2A 40 2A BE 3A FC 3A FA 3A F8 3B 38 3B 78 3B B6 4B B6 4B F4 4B F4 6C 34 84 74 00 00 00 00 00 00
					39 01 00 00 00 00 02 FA 00
					39 01 00 00 00 00 02 B0 80
					39 01 00 00 00 00 04 B2 41 08 00
					39 01 00 00 00 00 2B BE 00 00 00 00 00 00 00 00 00 00 40 00 00 00 00 00 00 00 00 00 00 00 00 00 00 00 40 00 00 00 00 00 00 00 00 00 00 00 00 00 00 00
					39 01 00 00 00 00 96 CA 00 00 00 00 00 00 00 03 00 00 00 00 03 00 00 00 00 03 00 00 00 00 03 00 00 00 00 03 00 00 00 00 03 00 00 00 00 03 00 00 00 00 03 00 00 00 00 03 00 00 00 00 03 00 00 00 00 03 00 00 00 00 03 00 00 00 00 03 00 00 00 00 03 00 00 00 00 03 00 00 00 00 03 00 00 00 00 03 00 00 00 00 03 00 00 00 00 00 00 00 00 00 00 00 00 00 00 00 00 00 00 00 00 00 00 00 00 00 00 00 00 00 00 00 00 00 00 00 00 00 00 00 00 00 00 00 00 00 00 00 00 00 00 00 00 00 00 00 00
					39 01 00 00 00 00 0F D0 A9 6B 87 43 05 21 AB 89 67 45 23 01 80 00
					39 01 00 00 00 00 9F D1 03 00 00 00 00 00 30 0F 00 7B 00 00 3F 00 00 22 B0 01 21 C0 01 00 80 03 00 60 08 00 D0 89 00 80 8E 1F 50 90 20 60 90 41 30 92 81 30 92 FF F7 FF FF F7 FF FF F7 FF FF F7 FF FF F7 FF FF F7 FF FF F7 FF FF F7 FF FF F7 FF FF F7 FF FF F7 FF FF F7 FF FF F7 FF FF F7 FF FF F7 FF FF F7 FF FF F7 FF FF F7 FF FF F7 FF FF F7 FF FF F7 FF FF F7 FF FF F7 FF FF F7 FF 68 01 81 2F 61 81 2B C1 86 2B D1 86 2F 21 8C 68 81 8C 69 01 81 A1 61 81 A5 C1 86 A5 D1 86 A1 21 8C 69 81 8C 00 00 F0 00 F0
					39 01 00 00 00 00 75 D2 1D 87 01 14 00 00 5D 3E 00 3C CF F3 3C CF F3 3C CF F3 2C 16 8B C5 62 B1 58 2C 16 8B 95 D8 FF 0F 09 80 04 52 02 20 81 44 00 20 80 10 00 08 20 29 D5 0A 00 00 B5 A6 94 52 AD 00 00 50 6B 4A 84 58 4B 08 00 EF BD 07 84 58 4B 08 00 EF BD 47 88 B5 84 00 F0 DE 7B 29 D5 0A 00 00 B5 A6 04 05 24 00 00 00 09 14 00 06 48 60 00 00 0E 38 E0 80 06 00 00 A0 81 03
					39 01 00 00 00 00 6D D3 00 FF FF FF 00 20 40 60 80 A0 C0 E0 FF 00 03 0C 1E 38 5B 89 C0 FF 00 03 0C 1E 38 5B 89 C0 FF 00 03 0C 1E 38 5B 89 C0 FF FF FF FF FF FF FF FF FF FF FF FF FF FF FF FF FF FF FF FF FF FF FF FF FF FF FF FF FF FF FF FF FF FF FF FF 80 80 80 80 80 80 80 80 80 80 80 80 80 80 80 80 80 80 80 80 80 80 80 80 80 80 80 80 80 80 80 80 80
					39 01 00 00 00 00 3C D4 93 93 60 1E E1 04 00 04 00 04 00 04 00 04 00 04 00 04 00 04 00 04 00 04 00 04 00 04 00 0F FF 00 00 0F FF 00 00 0F FF 00 00 03 20 00 F0 03 7D 01 00 4D 8B 00 4D 8B 00 4D 8B 03 38
					39 01 00 00 00 00 09 D8 01 81 87 0F 00 FF 00 FF
					39 01 00 00 00 00 03 D9 00 00
					39 01 00 00 00 00 05 DD C1 0D 00 02
					39 01 00 00 00 00 14 DE 30 00 1C 00 1C 00 1C 00 1C 10 00 1C 00 1C 00 1C 02 00 00
					39 01 00 00 00 00 60 DF A7 50 00 00 00 00 00 10 13 28 28 A0 AA AA AA AA AA AA AA AA AA AA 00 00 00 00 03 84 00 09 00 1A 45 3E 00 00 33 32 00 00 26 00 26 00 00 25 01 00 00 00 00 00 00 00 00 00 00 00 14 B9 00 00 00 00 00 00 00 00 F5 00 00 00 00 00 00 00 00 00 00 00 00 00 00 00 00 00 00 00 AA AA 0A AA AA 0A 0A
					39 01 00 00 00 00 10 E0 00 FB FF F7 1F 1B 3A BA 77 03 3F 8F 0B 77 07
					39 01 00 00 00 00 0B E1 23 00 01 1A 0F FF 00 00 00 00
					39 01 00 00 00 00 38 E2 00 00 03 FF 03 FF 03 FF 03 FF 03 FF 03 FF 03 FF 03 FF 03 FF 03 FF 03 FF 03 FF 03 FF 03 FF 03 FF 03 FF 03 FF 03 FF 03 FF 03 FF 00 00 00 00 00 00 00 00 00 00 00 00 00
					39 01 00 00 00 00 02 E3 00
					39 01 00 00 00 00 CE E4 34 B4 00 00 00 3B 08 04 9A 01 00 00 3F 55 15 55 00 3F 55 05 55 00 00 00 00 00 00 00 00 00 00 00 00 00 00 00 00 00 00 00 00 00 00 00 00 00 00 00 00 00 00 00 00 00 00 00 00 00 00 00 00 00 00 00 00 00 00 00 00 00 00 00 00 00 00 00 00 00 00 00 00 00 00 00 00 00 00 00 00 00 00 00 00 00 00 00 00 00 00 00 00 00 00 00 00 00 00 00 00 00 00 00 00 00 00 00 00 00 00 00 00 00 00 00 00 00 00 00 00 00 00 3F C0 00 FF 00 00 00 00 00 00 00 00 00 00 00 00 00 00 00 00 3F C0 00 3F 00 3F C0 00 3F 00 00 00 00 00 00 00 00 00 00 00 00 00 00 00 00 00 00 00 14 00 00 05 14 00 00 00 00 00 08 00 00 00 00 00 08 00 00 00 00 00 08 00 1E 04
					39 01 00 00 00 00 66 E5 1E 0A 08 18 08 05 07 06 08 02 02 07 05 05 07 03 03 08 06 08 0A 0A 0A 08 18 08 08 09 0A 0B 08 09 09 0A 0A 0B 19 1A 1E 18 19 1E 0A 0A 06 08 00 00 00 00 00 00 00 00 00 12 54 4E C2 44 44 C8 48 50 50 50 90 14 50 10 54 10 50 44 04 04 04 04 04 08 0A 09 09 08 06 06 04 04 14 14 14 00 00 00 10 00 00 04 00 00 00
					39 01 00 00 00 00 3C ED 00 00 FF FF AA 0A 66 06 00 00 00 00 00 00 00 00 00 00 00 00 00 00 00 00 00 00 00 00 00 00 00 00 00 00 00 00 00 00 00 00 00 00 00 00 00 00 00 00 00 00 88 88 88 88 88 88 88 88 08
					39 01 00 00 00 00 02 E6 00
					39 01 00 00 00 00 02 B0 04
					39 01 00 00 00 00 03 DF 50 40
					39 01 00 00 00 00 06 F3 50 00 00 00 00
					39 01 00 00 00 00 02 F2 11
					39 01 00 00 00 00 06 F3 01 00 00 00 01
					39 01 00 00 00 00 03 F4 00 02
					39 01 00 00 00 00 02 F2 19
					39 01 00 00 00 00 03 DF 50 42
					39 01 00 00 00 00 03 51 0F FF
					39 01 00 00 00 00 02 35 00
					39 01 00 00 00 00 05 2A 00 00 04 37
					39 01 00 00 00 00 05 2B 00 00 09 23
					05 01 00 00 8C 00 02 11 00
					05 01 00 00 14 00 02 29 00
				];

				qcom,mdss-dsi-timing-switch-command = [
					39 01 00 00 00 00 02 B0 00
					39 01 00 00 00 00 20 B3 00 22 00 02 08 00 10 00 00 00 00 00 00 00 00 00 00 00 00 00 00 00 00 00 00 00 00 00 00 00 04
					39 01 00 00 00 00 03 B4 20 1C
					39 01 00 00 00 00 0D B6 6C 00 06 23 AF 13 1A 05 04 FA 05 20
					39 01 00 00 00 00 02 B8 57
					39 01 00 00 00 00 02 B9 6F
					39 01 00 00 00 00 02 BA B5
					39 01 00 00 00 00 32 BB 59 C8 C8 C8 C8 C8 C8 C8 C8 C8 4A 48 46 44 42 40 3E 3C 3A 00 FF FF FF FF FF FF FF FF FF 04 00 04 04 42 04 69 5A 00 0B 76 0F FF 0F FF 0F FF 14 81 F4
					39 01 00 00 00 00 0C BC 45 26 C3 1F 19 06 03 C0 00 00 10
					39 01 00 00 00 00 0C BD 33 4C C3 52 32 1F 03 F2 00 00 13
					39 01 00 00 00 00 0C BE 25 68 C3 AA 3F 32 03 FF 00 00 25
					39 01 00 00 00 00 0D C0 00 00 00 00 00 00 00 00 00 00 00 00
					39 01 00 00 00 00 7D C1 94 42 00 16 05 00 00 00 10 00 10 00 AA 8A 02 10 00 10 00 00 3F 3F 03 FF 03 FF 23 FF 03 FF 23 FF 03 FF 00 40 40 00 00 10 06 00 06 00 00 00 10 00 00 00 00 10 00 00 00 00 10 00 00 20 02 10 01 10 00 00 00 00 00 20 04 20 02 10 00 00 00 00 00 00 00 10 00 00 00 00 00 00 00 00 00 10 00 00 00 00 00 00 00 00 00 00 00 00 00 00 00 00 00 00 00 00 00 00 00 00 00 00 00 00 00 00 00 00
					39 01 00 00 00 00 1A C2 09 24 0C 00 00 10 00 00 00 09 40 00 00 00 00 00 00 00 00 00 00 00 30 00 6C
					39 01 00 00 00 00 29 C3 00 12 30 02 88 88 A8 A8 A8 A8 A8 A8 A8 A8 A8 A8 A8 A8 A8 A8 A8 A8 A8 A8 AA 09 00 00 10 00 00 00 00 00 00 00 00 00 00 00
					39 01 00 00 00 00 32 C4 00 00 00 00 00 00 00 00 0D 00 00 05 00 00 00 36 00 01 00 00 00 00 00 00 00 00 00 00 00 22 00 00 00 00 11 00 00 0C 00 00 00 00 30 00 00 00 00 00 00
					39 01 00 00 00 00 0A C5 0A 00 4D 8B 4D 8B 4D 8B 00
					39 01 00 00 00 00 91 C6 00 00 03 FF 0F FC 03 FF 0F FC 03 FF 0F FC 03 FF 0F FC 03 FF 0F FC 03 FF 0F FC 03 FF 0F FC 03 FF 0F FC 03 FF 0F FC 03 FF 0F FC 03 FF 0F FC 0F FC 00 00 03 FF 0F FC 03 FF 0F FC 03 FF 0F FC 03 FF 0F FC 03 FF 0F FC 03 FF 0F FC 03 FF 0F FC 03 FF 0F FC 03 FF 0F FC 03 FF 0F FC 03 FF 0F FC 0F FC 00 00 03 FF 0F FC 03 FF 0F FC 03 FF 0F FC 03 FF 0F FC 03 FF 0F FC 03 FF 0F FC 03 FF 0F FC 03 FF 0F FC 03 FF 0F FC 03 FF 0F FC 03 FF 0F FC 0F FC
					39 01 00 00 00 00 91 C7 00 00 00 04 02 A2 00 08 02 A3 00 24 03 F6 00 40 04 3B 00 90 05 BA 01 01 06 AA 01 81 07 C9 02 02 08 6E 02 82 09 27 03 23 09 DE 03 83 0A 51 0A D5 00 00 00 04 02 6F 00 08 02 70 00 24 04 19 00 40 04 84 00 90 05 B6 01 01 06 9E 01 81 07 A0 02 02 08 42 02 82 08 EC 03 23 09 97 03 83 0A 00 0A 78 00 00 00 04 05 77 00 08 05 78 00 24 05 88 00 40 05 F2 00 90 06 F8 01 01 07 E9 01 81 08 E7 02 02 09 95 02 82 0A 53 03 23 0B 16 03 83 0B 8E 0C 19
					39 01 00 00 00 00 91 C8 00 00 00 04 02 A5 00 08 02 A6 00 24 03 63 00 40 04 04 00 90 05 FF 01 01 06 CE 01 81 07 F1 02 02 08 A2 02 82 09 5E 03 23 0A 26 03 83 0A A4 0B 34 00 00 00 04 03 16 00 08 03 17 00 24 03 D1 00 40 04 34 00 90 05 B9 01 01 06 92 01 81 07 A2 02 02 08 4F 02 82 09 07 03 23 09 C7 03 83 0A 37 0A C6 00 00 00 04 04 28 00 08 04 29 00 24 04 AB 00 40 05 52 00 90 06 CF 01 01 07 C5 01 81 08 EA 02 02 09 AA 02 82 0A 77 03 23 0B 4D 03 83 0B D2 0C 71
					39 01 00 00 00 00 91 C9 00 00 00 04 02 36 00 08 02 37 00 24 03 53 00 40 04 2F 00 90 05 FF 01 01 06 DE 01 81 07 FB 02 02 08 BC 02 82 09 87 03 23 0A 64 03 83 0A EF 0B 9F 00 00 00 04 02 B6 00 08 02 B7 00 24 03 63 00 40 04 01 00 90 05 AD 01 01 06 8E 01 81 07 A8 02 02 08 63 02 82 09 29 03 23 09 FC 03 83 0A 84 0B 21 00 00 00 04 03 7D 00 08 03 7E 00 24 04 4A 00 40 05 12 00 90 06 C0 01 01 07 C4 01 81 08 F3 02 02 09 C0 02 82 0A 9D 03 23 0B 89 03 83 0C 25 0C D8
					39 01 00 00 00 00 91 CA 00 00 00 04 02 02 00 08 02 03 00 24 03 F8 00 40 04 52 00 90 05 FF 01 01 06 EF 01 81 08 1B 02 02 08 E7 02 82 09 CB 03 23 0A D2 03 83 0B 6B 0C 53 00 00 00 04 02 8F 00 08 02 90 00 24 03 3F 00 40 03 FC 00 90 05 AC 01 01 06 9B 01 81 07 C4 02 02 08 88 02 82 09 6A 03 23 0A 66 03 83 0A F1 0B C8 00 00 00 04 03 22 00 08 03 23 00 24 04 71 00 40 05 0F 00 90 06 C0 01 01 07 D0 01 81 09 0C 02 02 09 E9 02 82 0A DF 03 23 0B F9 03 83 0C A3 0D 98
					39 01 00 00 00 00 91 CB 00 00 00 04 02 20 00 08 02 21 00 24 04 29 00 40 04 91 00 90 06 51 01 01 07 4D 01 81 08 83 02 02 09 77 02 82 0A 6F 03 23 0B AF 03 83 0C 62 0D 99 00 00 00 04 02 8B 00 08 02 8C 00 24 03 7B 00 40 04 3A 00 90 06 05 01 01 06 FD 01 81 08 35 02 02 09 1B 02 82 0A 09 03 23 0B 30 03 83 0B E3 0C ED 00 00 00 04 03 28 00 08 03 29 00 24 04 C5 00 40 05 45 00 90 07 1F 01 01 08 35 01 81 09 80 02 02 0A 86 02 82 0B 8A 03 23 0C DF 03 83 0D A7 0E F8
					39 01 00 00 00 00 44 CD 1C 00 FC FC FC 00 00 00 00 00 00 00 00 00 00 00 00 00 00 00 00 00 00 00 00 00 00 00 00 00 00 00 00 00 00 00 00 00 00 00 00 00 00 00 00 00 00 00 00 00 00 00 00 00 00 00 00 00 00 00 00 00 00 00 00 08 00
					39 01 00 00 00 00 86 CF 64 0B 00 22 00 CD 03 33 08 00 0B 77 01 01 01 02 02 03 03 04 04 04 04 05 02 C9 02 C9 02 C9 02 C9 02 C9 02 C9 02 C9 02 C9 02 C9 03 FF 03 FF 03 FF 02 C9 02 C9 02 C9 02 C9 02 C9 02 C9 02 C9 02 C9 02 C9 03 FF 03 FF 03 FF 01 62 01 62 01 62 01 62 01 62 01 62 01 62 01 62 01 62 01 62 01 62 01 62 23 23 23 23 23 23 23 23 23 23 23 23 00 00 00 43 00 43 01 98 01 98 06 61 06 61 0F F6 0F F6 0F F6 0F F6 0F F6 19
					39 01 00 00 00 00 0D D0 44 44 B2 28 00 28 5A 00 5A 0D 17 01
					39 01 00 00 00 00 40 D1 0B 00 21 02 24 23 24 48 00 00 00 00 00 00 00 00 00 00 00 00 00 00 00 00 00 00 00 00 00 00 00 00 00 00 00 00 00 00 00 00 00 00 00 00 00 00 00 00 00 00 00 00 4A 00 4A 00 4A 00 4A 00 4A 00 01
					39 01 00 00 00 00 35 D3 45 00 00 01 13 15 00 15 07 0F 77 77 77 37 B2 11 00 A0 3C 95 00 3E 6A 10 60 10 01 03 73 07 FF 04 44 33 33 83 04 00 00 00 00 00 00 00 3C 00 7E 7E 7E 00 42 01
					39 01 00 00 00 00 12 D4 00 00 00 00 00 00 00 00 20 00 00 00 00 00 20 00 00
					39 01 00 00 00 00 04 D5 00 00 00
					39 01 00 00 00 00 02 D6 00
					39 01 00 00 00 00 1A D7 00 B9 40 00 40 00 00 E0 0E 00 40 00 00 00 00 00 00 19 40 00 00 00 00 E0 0E
					39 01 00 00 00 00 3C D8 00 00 00 00 00 00 00 00 00 3C 00 3C 00 3C 00 3C 00 3C 05 00 00 00 00 00 00 00 00 00 0E 00 0E 00 00 00 00 00 00 00 00 00 00 00 00 00 0E 00 36 00 0E 00 30 00 00 00 00 00 00 00 00
					39 01 00 00 00 00 7A D9 00 13 12 1B 1A 02 00 00 00 00 00 00 00 00 00 00 00 00 00 00 00 00 00 00 00 00 00 00 00 00 00 00 00 00 00 00 00 00 00 00 00 00 00 00 96 1A 1B 12 13 00 00 00 00 00 00 00 00 00 00 00 00 00 00 00 00 00 00 00 00 00 00 00 00 00 00 00 00 00 00 00 00 00 00 00 00 00 00 00 00 00 00 00 00 00 00 00 00 00 00 00 00 00 00 00 00 00 00 00 08 1F 00 00 00 00 F0 00 00 00 00 00 00
					39 01 00 00 00 00 09 DD 30 06 23 65 30 06 23 65
					39 01 00 00 00 00 0E DE 01 10 10 00 4D 8B 55 4D 8B AA 4D 8B F0
					39 01 00 00 00 00 2B DF 50 42 58 81 2D 00 00 00 00 00 00 6B 00 00 00 00 00 00 00 00 21 00 FF D4 0E 00 00 00 00 00 20 00 53 18 20 00 00 00 00 00 00 00
					39 01 00 00 00 00 1A E9 00 00 00 0F FF 00 00 00 00 00 00 10 00 01 FF 03 FF 01 0E 02 58 02 1C 04 B0
					39 01 00 00 00 00 03 EB 8B 8B
					39 01 00 00 00 00 02 F7 01
					39 01 00 00 00 00 02 F2 00
					39 01 00 00 00 00 06 F3 00 00 00 00 00
					39 01 00 00 00 00 BD F8 11 00 00 89 30 80 09 24 04 38 00 14 02 1C 02 1C 02 00 02 0E 00 20 01 E8 00 07 00 0C 05 0E 05 16 18 00 10 F0 03 0C 20 00 06 0B 0B 33 0E 1C 2A 38 46 54 62 69 70 77 79 7B 7D 7E 01 02 01 00 09 40 09 BE 19 FC 19 FA 19 F8 1A 38 1A 78 1A B6 2A F6 2B 34 2B 74 3B 74 6B F4 00 00 00 00 00 00 11 00 00 AB 30 80 09 24 04 38 00 14 02 1C 02 1C 02 00 02 0E 00 20 01 E8 00 07 00 0C 05 0E 05 16 18 00 10 F0 07 10 20 00 06 0F 0F 33 0E 1C 2A 38 46 54 62 69 70 77 79 7B 7D 7E 02 02 22 00 2A 40 2A BE 3A FC 3A FA 3A F8 3B 38 3B 78 3B B6 4B B6 4B F4 4B F4 6C 34 84 74 00 00 00 00 00 00
					39 01 00 00 00 00 02 FA 00
					39 01 00 00 00 00 02 B0 80
					39 01 00 00 00 00 04 B2 41 08 00
					39 01 00 00 00 00 2B BE 00 00 00 00 00 00 00 00 00 00 40 00 00 00 00 00 00 00 00 00 00 00 00 00 00 00 40 00 00 00 00 00 00 00 00 00 00 00 00 00 00 00
					39 01 00 00 00 00 96 CA 00 00 00 00 00 00 00 03 00 00 00 00 03 00 00 00 00 03 00 00 00 00 03 00 00 00 00 03 00 00 00 00 03 00 00 00 00 03 00 00 00 00 03 00 00 00 00 03 00 00 00 00 03 00 00 00 00 03 00 00 00 00 03 00 00 00 00 03 00 00 00 00 03 00 00 00 00 03 00 00 00 00 03 00 00 00 00 03 00 00 00 00 03 00 00 00 00 00 00 00 00 00 00 00 00 00 00 00 00 00 00 00 00 00 00 00 00 00 00 00 00 00 00 00 00 00 00 00 00 00 00 00 00 00 00 00 00 00 00 00 00 00 00 00 00 00 00 00 00
					39 01 00 00 00 00 0F D0 A9 6B 87 43 05 21 AB 89 67 45 23 01 80 00
					39 01 00 00 00 00 9F D1 03 00 00 00 00 00 30 0F 00 7B 00 00 3F 00 00 22 B0 01 21 C0 01 00 80 03 00 60 08 00 D0 89 00 80 8E 1F 50 90 20 60 90 41 30 92 81 30 92 FF F7 FF FF F7 FF FF F7 FF FF F7 FF FF F7 FF FF F7 FF FF F7 FF FF F7 FF FF F7 FF FF F7 FF FF F7 FF FF F7 FF FF F7 FF FF F7 FF FF F7 FF FF F7 FF FF F7 FF FF F7 FF FF F7 FF FF F7 FF FF F7 FF FF F7 FF FF F7 FF FF F7 FF 68 01 81 2F 61 81 2B C1 86 2B D1 86 2F 21 8C 68 81 8C 69 01 81 A1 61 81 A5 C1 86 A5 D1 86 A1 21 8C 69 81 8C 00 00 F0 00 F0
					39 01 00 00 00 00 75 D2 1D 87 01 14 00 00 5D 3E 00 3C CF F3 3C CF F3 3C CF F3 2C 16 8B C5 62 B1 58 2C 16 8B 95 D8 FF 0F 09 80 04 52 02 20 81 44 00 20 80 10 00 08 20 29 D5 0A 00 00 B5 A6 94 52 AD 00 00 50 6B 4A 84 58 4B 08 00 EF BD 07 84 58 4B 08 00 EF BD 47 88 B5 84 00 F0 DE 7B 29 D5 0A 00 00 B5 A6 04 05 24 00 00 00 09 14 00 06 48 60 00 00 0E 38 E0 80 06 00 00 A0 81 03
					39 01 00 00 00 00 6D D3 00 FF FF FF 00 20 40 60 80 A0 C0 E0 FF 00 03 0C 1E 38 5B 89 C0 FF 00 03 0C 1E 38 5B 89 C0 FF 00 03 0C 1E 38 5B 89 C0 FF FF FF FF FF FF FF FF FF FF FF FF FF FF FF FF FF FF FF FF FF FF FF FF FF FF FF FF FF FF FF FF FF FF FF FF 80 80 80 80 80 80 80 80 80 80 80 80 80 80 80 80 80 80 80 80 80 80 80 80 80 80 80 80 80 80 80 80 80
					39 01 00 00 00 00 3C D4 93 93 60 1E E1 04 00 04 00 04 00 04 00 04 00 04 00 04 00 04 00 04 00 04 00 04 00 04 00 0F FF 00 00 0F FF 00 00 0F FF 00 00 03 20 00 F0 03 7D 01 00 4D 8B 00 4D 8B 00 4D 8B 03 38
					39 01 00 00 00 00 09 D8 01 81 87 0F 00 FF 00 FF
					39 01 00 00 00 00 03 D9 00 00
					39 01 00 00 00 00 05 DD C1 0D 00 02
					39 01 00 00 00 00 14 DE 30 00 1C 00 1C 00 1C 00 1C 10 00 1C 00 1C 00 1C 02 00 00
					39 01 00 00 00 00 60 DF A7 50 00 00 00 00 00 10 13 28 28 A0 AA AA AA AA AA AA AA AA AA AA 00 00 00 00 03 84 00 09 00 1A 45 3E 00 00 33 32 00 00 26 00 26 00 00 25 01 00 00 00 00 00 00 00 00 00 00 00 14 B9 00 00 00 00 00 00 00 00 F5 00 00 00 00 00 00 00 00 00 00 00 00 00 00 00 00 00 00 00 AA AA 0A AA AA 0A 0A
					39 01 00 00 00 00 10 E0 00 FB FF F7 1F 1B 3A BA 77 03 3F 8F 0B 77 07
					39 01 00 00 00 00 0B E1 23 00 01 1A 0F FF 00 00 00 00
					39 01 00 00 00 00 38 E2 00 00 03 FF 03 FF 03 FF 03 FF 03 FF 03 FF 03 FF 03 FF 03 FF 03 FF 03 FF 03 FF 03 FF 03 FF 03 FF 03 FF 03 FF 03 FF 03 FF 03 FF 00 00 00 00 00 00 00 00 00 00 00 00 00
					39 01 00 00 00 00 02 E3 00
					39 01 00 00 00 00 CE E4 34 B4 00 00 00 3B 08 04 9A 01 00 00 3F 55 15 55 00 3F 55 05 55 00 00 00 00 00 00 00 00 00 00 00 00 00 00 00 00 00 00 00 00 00 00 00 00 00 00 00 00 00 00 00 00 00 00 00 00 00 00 00 00 00 00 00 00 00 00 00 00 00 00 00 00 00 00 00 00 00 00 00 00 00 00 00 00 00 00 00 00 00 00 00 00 00 00 00 00 00 00 00 00 00 00 00 00 00 00 00 00 00 00 00 00 00 00 00 00 00 00 00 00 00 00 00 00 00 00 00 00 00 00 3F C0 00 FF 00 00 00 00 00 00 00 00 00 00 00 00 00 00 00 00 3F C0 00 3F 00 3F C0 00 3F 00 00 00 00 00 00 00 00 00 00 00 00 00 00 00 00 00 00 00 14 00 00 05 14 00 00 00 00 00 08 00 00 00 00 00 08 00 00 00 00 00 08 00 1E 04
					39 01 00 00 00 00 66 E5 1E 0A 08 18 08 05 07 06 08 02 02 07 05 05 07 03 03 08 06 08 0A 0A 0A 08 18 08 08 09 0A 0B 08 09 09 0A 0A 0B 19 1A 1E 18 19 1E 0A 0A 06 08 00 00 00 00 00 00 00 00 00 12 54 4E C2 44 44 C8 48 50 50 50 90 14 50 10 54 10 50 44 04 04 04 04 04 08 0A 09 09 08 06 06 04 04 14 14 14 00 00 00 10 00 00 04 00 00 00
					39 01 00 00 00 00 3C ED 00 00 FF FF AA 0A 66 06 00 00 00 00 00 00 00 00 00 00 00 00 00 00 00 00 00 00 00 00 00 00 00 00 00 00 00 00 00 00 00 00 00 00 00 00 00 00 00 00 00 00 88 88 88 88 88 88 88 88 08
					39 01 00 00 00 00 02 E6 00
					39 01 00 00 00 00 02 B0 04
					39 01 00 00 00 00 03 DF 50 40
					39 01 00 00 00 00 06 F3 50 00 00 00 00
					39 01 00 00 00 00 02 F2 11
					39 01 00 00 00 00 06 F3 01 00 00 00 01
					39 01 00 00 00 00 03 F4 00 02
					39 01 00 00 00 00 02 F2 19
					39 01 00 00 00 00 03 DF 50 42
					39 01 00 00 00 00 03 51 0F FF
					39 01 00 00 00 00 02 35 00
					39 01 00 00 00 00 05 2A 00 00 04 37
					39 01 00 00 00 00 05 2B 00 00 09 23
				];

				qcom,mdss-dsi-off-command = [
					05 01 00 00 64 00 02 28 00
					05 01 00 00 32 00 02 10 00];
				qcom,mdss-dsi-on-command-state = "dsi_lp_mode";
				qcom,mdss-dsi-off-command-state = "dsi_hs_mode";

				/* ACL function */
				nubia,mdss-dsi-cabc-command-off = [
					15 01 00 00 00 00 02 55 00];
				nubia,mdss-dsi-cabc-command-level1 = [
					15 01 00 00 00 00 02 55 01];
				nubia,mdss-dsi-cabc-command-level2 = [
					15 01 00 00 00 00 02 55 02];
				nubia,mdss-dsi-cabc-command-level3 = [
					15 01 00 00 00 00 02 55 03];
				nubia,mdss-dsi-cabc-command-off-state = "dsi_hs_mode";
				nubia,mdss-dsi-cabc-command-level1-state = "dsi_hs_mode";
				nubia,mdss-dsi-cabc-command-level2-state = "dsi_hs_mode";
				nubia,mdss-dsi-cabc-command-level3-state = "dsi_hs_mode";

				/* AOD function */
				qcom,mdss-dsi-nolp-command = [
					39 01 00 00 00 00 02 B0 80
					39 01 00 00 00 00 02 DF B4
					39 01 00 00 00 00 02 53 04
					39 01 00 00 50 00 03 51 00 00
					39 01 00 00 00 00 02 38 00
					39 01 00 00 00 00 02 B0 04
					39 01 00 00 64 00 0C C2 09 24 0C 00 00 10 09 40 00 09 40
					39 01 00 00 00 00 0C C2 09 24 0C 00 00 10 00 00 00 09 40
					39 01 00 00 00 00 4A C1 94 42 00 16 05 00 00 00 10 00 10 00 AA 8A 02 10 00 10 00 00 3F 3F 03 FF 03 FF 23 FF 03 FF 23 FF 03 FF 00 40 40 00 00 10 06 00 06 00 00 00 10 00 00 00 00 10 00 00 00 00 10 00 00 20 02 10 01 10 00 00 00 00 00 20 04 20 02
					39 01 00 00 00 00 33 D3 45 00 00 01 13 15 00 15 07 0F 77 77 77 37 B2 11 00 A0 3C 95 00 3E 6A 10 60 10 01 03 73 07 FF 04 44 33 33 83 04 00 00 00 00 00 00 00 3C 00 7E 7E 7E 00
					39 01 00 00 00 00 1A D7 00 B9 40 00 40 00 00 E0 0E 00 40 00 00 00 00 00 00 19 40 00 00 00 00 E0 0E
					39 01 00 00 00 00 34 D8 00 00 00 00 00 00 00 00 00 3C 00 3C 00 3C 00 3C 00 3C 05 00 00 00 00 00 00 00 00 00 0E 00 0E 00 00 00 00 00 00 00 00 00 00 00 00 00 0E 00 36 00 0E 00 30
				];

				qcom,mdss-dsi-lp1-command = [
					39 01 00 00 14 00 02 53 04
					39 01 00 00 00 00 02 B0 80
					39 01 00 00 14 00 02 DF B4
					39 01 00 00 00 00 02 39 00
					39 01 00 00 00 00 02 B0 04
					39 01 00 00 00 00 03 E8 00 02
					39 01 00 00 00 00 03 E4 00 34
					39 01 00 00 00 00 02 B0 04
					39 01 00 00 00 00 7D C1 D4 42 00 3F 0F 00 00 00 10 00 10 00 AA 8A 02 10 00 10 00 00 3F 3F 03 FF 03 FF 23 FF 03 FF 23 FF 03 FF F0 40 40 00 00 10 06 00 06 00 00 00 10 00 00 00 00 10 00 00 00 00 10 00 00 20 02 10 01 10 00 00 00 00 00 20 04 20 03 10 00 00 00 00 00 00 00 10 00 00 00 00 00 00 00 00 00 10 00 00 00 00 00 00 00 00 00 00 00 00 00 00 00 00 00 00 00 00 00 00 00 00 00 00 00 00 00 00 00 00
					39 01 00 00 00 00 35 D3 45 00 00 01 13 15 00 15 07 0F 77 77 77 37 B2 11 00 A0 3C 9C 00 3E 6A 10 60 10 01 03 73 01 11 01 11 33 33 83 04 00 00 00 00 00 00 00 3C 00 7E 7E 7E 03 42 01
					39 01 00 00 00 00 1A D7 00 B9 40 00 40 00 02 C0 2C 00 40 00 00 00 00 00 00 19 40 00 00 00 02 C0 2C
					39 01 00 00 00 00 3C D8 00 00 00 00 00 00 00 00 00 5B 00 5B 00 5B 00 5B 00 5B 05 00 00 00 00 00 00 00 00 00 2C 00 2C 00 00 00 00 00 00 00 00 00 00 00 00 00 2C 00 6D 00 2C 00 0C 00 00 00 00 00 00 00 00
				];
				qcom,mdss-dsi-nolp-command-state = "dsi_hs_mode";
				qcom,mdss-dsi-lp1-command-state = "dsi_hs_mode";

				/* HBM function */
				nubia,mdss-dsi-hbm-command-on = [
					39 01 00 00 00 00 02 B0 00
					15 01 00 00 00 00 02 53 E8];
				nubia,mdss-dsi-hbm-command-off = [
					39 01 00 00 00 00 02 B0 00
					15 01 00 00 00 00 02 53 00];
				nubia,mdss-dsi-hbm-fp-command-on = [
					39 01 00 00 00 00 02 B0 00
					15 01 00 00 00 00 02 53 E0];
				nubia,mdss-dsi-hbm-fp-command-off = [
					39 01 00 00 00 00 02 B0 00
					15 01 00 00 00 00 02 53 00];
				nubia,mdss-dsi-hbm-command-on-state = "dsi_hs_mode";
				nubia,mdss-dsi-hbm-command-off-state = "dsi_hs_mode";
				nubia,mdss-dsi-hbm-fp-command-on-state = "dsi_hs_mode";
				nubia,mdss-dsi-hbm-fp-command-off-state = "dsi_hs_mode";

				/* DSC parameter */
				qcom,mdss-dsi-h-sync-pulse = <0>;
				qcom,compression-mode = "dsc";
				qcom,mdss-dsc-slice-height = <20>;
				qcom,mdss-dsc-slice-width = <540>;
				qcom,mdss-dsc-slice-per-pkt = <2>;
				qcom,mdss-dsc-bit-per-component = <8>;
				qcom,mdss-dsc-bit-per-pixel = <8>;
				qcom,mdss-dsc-block-prediction-enable;
			};
		};
	};
};
