## drivers/ese/Kconfig
```kconfig
#
# Near Field Communication (NFC) devices
#

menu "secure element (ESE) devices"


config NUBIA_ESE
	bool "Nubia ese driver"
	default n
	help
	  NUBIA ESE Driver.
	  This driver provides support for SAMSUNG(Thales) ESE products.

	  Say Y here to compile support for NUBIA ese driver into the
	  kernel.

endmenu
```

## drivers/fan/Kconfig
```kconfig
#
# Fan driver configuration
#
menuconfig NUBIA_FAN
	bool "Fan"
	default n
	help
	  Say Y here if you have a Fan connected
	  to your system.

if NUBIA_FAN

config FAN_CORE
	tristate "Fan core"
	default n

config FAN_REMOVE_FOR_GKI
      bool "Fan gki"
      default n

config FAN_REMOVE_RPM_CORRECT
       bool "Fan no rpm correct"
        default n
        help
          Say Y here if you have a Fan rpm correct
          to your system.

#config FAN_UPDATA
#	bool "Fan updata"
#	default n

endif
```

## drivers/input/keyboard/cy8c4014l_touchkey/Kconfig
```kconfig
config NUBIA_CYPRESS_KEYBOARD_GAMEFIRE
        tristate "Keypad NUBIA GameFire"
        depends on KEYBOARD_GPIO
	default n
        help
          Addr GameSwitchkey attr
```

## drivers/nubia/Kconfig
```kconfig
#
# Nubia drivers configuration
#

#menuconfig NUBIA_DRIVERS
menu "nubia drivers"

config NUBIA_DRIVERS
	tristate "NUBIA DRIVERS"
	default n
	help
	  Say Y here if you want to enable NUBIA DRIVERS
	  If unsure, say N.

comment "Nubia Device Drivers"

if NUBIA_DRIVERS


config NUBIA_TOUCH
	bool "NUBIA_TOUCH"
	default n
	help
	 Say Y here if you have enable NUBIA_FINGERPRINT
	 IF  unsure ,say N

config NUBIA_EC_COLOR
    bool "NUBIA_EC_COLOR"
    default n
    help
     Say Y here if you have enable NUBIA_EC_COLOR
     IF  unsure ,say N

config NUBIA_SENSORS
        bool "NUBIA_SENSORS"
        default n
        help
         Say Y here if you have enable NUBIA_SENSORS
         IF  unsure ,say N

config NUBIA_FINGERPRINT
        tristate "NUBIA_FINGERPRINT"
        default n
        help
         Say Y here if you have enable NUBIA_FINGERPRINT
         IF  unsure ,say N

config NUBIA_DP
        bool "NUBIA_DP"
        default n
        help
         Say Y here if you have enable NUBIA_DP
         IF  unsure ,say N

config NUBIA_LOG
        bool "NUBIA_LOG"
        default n
        help
         Say Y here if you have enable NUBIA_LOG
         IF  unsure ,say N

config NUBIA_SENSORS_SENS
        bool "NUBIA_SENSORS_SENS"
        default n
        help
         Say Y here if you have enable NUBIA_SENSORS_SENS
         IF  unsure ,say N

endif


if NUBIA_TOUCH
source "drivers/nubia/touch/Kconfig"
endif


if NUBIA_FINGERPRINT
source "drivers/nubia/fingerprint/Kconfig"
endif

if NUBIA_DP
source "drivers/nubia/dp/Kconfig"
endif

if NUBIA_SENSORS
source "drivers/nubia/stk3337/Kconfig"
endif

if NUBIA_SENSORS_SENS
source "drivers/nubia/sensors_sensitivity/Kconfig"
endif

config NUBIA_BYPASS_ACL
    bool "NUBIA_BYPASS_ACL"
    default n
    help
     Say Y here if you have enable NUBIA_BYPASS_ACL
     IF  unsure ,say N

config PS5013
    bool "PS5013"
    default n
    help
     Say Y here if you have enable PS5013
     IF  unsure ,say N

if NUBIA_LOG
source "drivers/nubia/nblog/Kconfig"
endif
endmenu
```

## drivers/nubia/dp/Kconfig
```kconfig
#
# ZTE SoC drivers
#

config NUBIA_USB_DP_MODULES
	bool "NUBIA USB DP MODULES"
	default n
	help
	  usb switch to dp function
```

## drivers/nubia/fingerprint/goodix/Kconfig
```kconfig
config NUBIA_FP_GOODIX_GW9658
	tristate "generic goodix GW9658 driver"
	default n
	help
	add support for goodix GW9658 driver.
```

## drivers/nubia/nblog/Kconfig
```kconfig
#
# ZTE SoC drivers
#

config NBLOG
	bool "NUBIA LOG MODULES"
	default n
	help
	  this function for big data; these logs are send to data service, and then to analyze.
```

## drivers/nubia/touch/goodix_berlin_driver_v1.0.1/Kconfig
```kconfig
#
# Goodix touchscreen driver configuration
#
menuconfig TOUCHSCREEN_GOODIX_BRL
	tristate "Goodix berlin touchscreen"
	depends on I2C
	default n
	help
	  Say Y here if you have a Goodix berlin series touch controller
	  to your system.

	  If unsure, say N.

if TOUCHSCREEN_GOODIX_BRL

config TOUCHSCREEN_GOODIX_BRL_I2C
	tristate "support I2C bus connection"
	default n
	help
	  y Y here if the touchscreen is connected via I2C bus.

	  If unsure, say N.

	  To compile this driver as a module, choose M here.

config TOUCHSCREEN_GOODIX_TS_TOOLS
	tristate "Goodix debug tools support"
	default n
	help
	  Say Y here to enable debug tools.

	  If unsure, say N.

	  To compile this driver as a module, choose M here.

config TOUCHSCREEN_GOODIX_TS_GESTURE
	tristate "Goodix gesture support"
	default n
	help
	  Say Y here to enable gesture.

	  If unsure, say N.

	  To compile this driver as a module, choose M here.

endif
```

## drivers/usb/nubia/Kconfig
```kconfig
#nubia add for usb test
config NUBIA_USB_TEST
        bool "NUBIA_USB_TEST"
        default n
        ---help---
          Add some usb test file node for factory test.
```
